/**
 * @file nucleo_f429zi.overlay
 * @author AH
 * @brief
 * @version 0.1
 * @date 2024-12-28
 *
 * @copyright Copyright (c) 2024
 *
 */

/ {
	load_switch: load_switch {
		compatible = "power-switch";
		/* using built-in LED pin for demonstration */
		gpios = <&gpiob 7 GPIO_ACTIVE_HIGH>;
	};
};
