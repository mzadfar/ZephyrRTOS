## 305_GPIOInOut/sample.yaml
```yaml
sample:
  name: Button Sample
tests:
  sample.basic.button:
    tags:
      - button
      - gpio
    filter: dt_enabled_alias_with_parent_compat("sw0", "gpio-keys")
    integration_platforms:
      - nucleo_f429zi 
    depends_on: gpio
    harness: button
```

## 309_CustomDTSBinding/build/Kconfig/arch/Kconfig
```kconfig
# Load Zephyr Arch Kconfig descriptions.
osource "/home/ah/Documents/Workspace/STM32/ZephyrProject/zephyr/arch/x86/Kconfig"
osource "/home/ah/Documents/Workspace/STM32/ZephyrProject/zephyr/arch/xtensa/Kconfig"
osource "/home/ah/Documents/Workspace/STM32/ZephyrProject/zephyr/arch/sparc/Kconfig"
osource "/home/ah/Documents/Workspace/STM32/ZephyrProject/zephyr/arch/riscv/Kconfig"
osource "/home/ah/Documents/Workspace/STM32/ZephyrProject/zephyr/arch/posix/Kconfig"
osource "/home/ah/Documents/Workspace/STM32/ZephyrProject/zephyr/arch/nios2/Kconfig"
osource "/home/ah/Documents/Workspace/STM32/ZephyrProject/zephyr/arch/mips/Kconfig"
osource "/home/ah/Documents/Workspace/STM32/ZephyrProject/zephyr/arch/arm64/Kconfig"
osource "/home/ah/Documents/Workspace/STM32/ZephyrProject/zephyr/arch/arm/Kconfig"
osource "/home/ah/Documents/Workspace/STM32/ZephyrProject/zephyr/arch/arc/Kconfig"
```

## 309_CustomDTSBinding/build/Kconfig/boards/Kconfig
```kconfig
# Load Zephyr board Kconfig descriptions.
osource "/home/ah/Documents/Workspace/STM32/ZephyrProject/zephyr/boards/st/nucleo_f429zi/Kconfig"
```

## 309_CustomDTSBinding/build/Kconfig/boards/Kconfig.defconfig
```kconfig
# Load Zephyr board defconfig descriptions.
osource "/home/ah/Documents/Workspace/STM32/ZephyrProject/zephyr/boards/st/nucleo_f429zi/Kconfig.defconfig"
```

## 309_CustomDTSBinding/build/Kconfig/boards/Kconfig.nucleo_f429zi
```kconfig
# Load board Kconfig descriptions.
osource "/home/ah/Documents/Workspace/STM32/ZephyrProject/zephyr/boards/st/nucleo_f429zi/Kconfig.nucleo_f429zi"
```

## 309_CustomDTSBinding/build/Kconfig/soc/Kconfig
```kconfig
# Load Zephyr SoC Kconfig descriptions.
osource "/home/ah/Documents/Workspace/STM32/ZephyrProject/zephyr/soc/xlnx/zynqmp/Kconfig"
osource "/home/ah/Documents/Workspace/STM32/ZephyrProject/zephyr/soc/xlnx/zynq7000/Kconfig"
osource "/home/ah/Documents/Workspace/STM32/ZephyrProject/zephyr/soc/xen/Kconfig"
osource "/home/ah/Documents/Workspace/STM32/ZephyrProject/zephyr/soc/wch/ch32v00x/Kconfig"
osource "/home/ah/Documents/Workspace/STM32/ZephyrProject/zephyr/soc/ti/simplelink/Kconfig"
osource "/home/ah/Documents/Workspace/STM32/ZephyrProject/zephyr/soc/ti/lm3s6965/Kconfig"
osource "/home/ah/Documents/Workspace/STM32/ZephyrProject/zephyr/soc/ti/k3/Kconfig"
osource "/home/ah/Documents/Workspace/STM32/ZephyrProject/zephyr/soc/telink/tlsr/Kconfig"
osource "/home/ah/Documents/Workspace/STM32/ZephyrProject/zephyr/soc/starfive/jh71xx/Kconfig"
osource "/home/ah/Documents/Workspace/STM32/ZephyrProject/zephyr/soc/st/stm32/Kconfig"
osource "/home/ah/Documents/Workspace/STM32/ZephyrProject/zephyr/soc/snps/qemu_arc/Kconfig"
osource "/home/ah/Documents/Workspace/STM32/ZephyrProject/zephyr/soc/snps/nsim/arc_v/Kconfig"
osource "/home/ah/Documents/Workspace/STM32/ZephyrProject/zephyr/soc/snps/nsim/arc_classic/Kconfig"
osource "/home/ah/Documents/Workspace/STM32/ZephyrProject/zephyr/soc/snps/hsdk4xd/Kconfig"
osource "/home/ah/Documents/Workspace/STM32/ZephyrProject/zephyr/soc/snps/hsdk/Kconfig"
osource "/home/ah/Documents/Workspace/STM32/ZephyrProject/zephyr/soc/snps/emsk/Kconfig"
osource "/home/ah/Documents/Workspace/STM32/ZephyrProject/zephyr/soc/snps/emsdp/Kconfig"
osource "/home/ah/Documents/Workspace/STM32/ZephyrProject/zephyr/soc/snps/arc_iot/Kconfig"
osource "/home/ah/Documents/Workspace/STM32/ZephyrProject/zephyr/soc/silabs/Kconfig"
osource "/home/ah/Documents/Workspace/STM32/ZephyrProject/zephyr/soc/sifive/sifive_freedom/Kconfig"
osource "/home/ah/Documents/Workspace/STM32/ZephyrProject/zephyr/soc/sensry/Kconfig"
osource "/home/ah/Documents/Workspace/STM32/ZephyrProject/zephyr/soc/rockchip/Kconfig"
osource "/home/ah/Documents/Workspace/STM32/ZephyrProject/zephyr/soc/renode/riscv_virtual/Kconfig"
osource "/home/ah/Documents/Workspace/STM32/ZephyrProject/zephyr/soc/renode/cortex_r8_virtual/Kconfig"
osource "/home/ah/Documents/Workspace/STM32/ZephyrProject/zephyr/soc/renesas/smartbond/Kconfig"
osource "/home/ah/Documents/Workspace/STM32/ZephyrProject/zephyr/soc/renesas/rzt2m/Kconfig"
osource "/home/ah/Documents/Workspace/STM32/ZephyrProject/zephyr/soc/renesas/rcar/Kconfig"
osource "/home/ah/Documents/Workspace/STM32/ZephyrProject/zephyr/soc/renesas/ra/Kconfig"
osource "/home/ah/Documents/Workspace/STM32/ZephyrProject/zephyr/soc/raspberrypi/Kconfig"
osource "/home/ah/Documents/Workspace/STM32/ZephyrProject/zephyr/soc/quicklogic/eos_s3/Kconfig"
osource "/home/ah/Documents/Workspace/STM32/ZephyrProject/zephyr/soc/qemu/virt_riscv/Kconfig"
osource "/home/ah/Documents/Workspace/STM32/ZephyrProject/zephyr/soc/qemu/malta/Kconfig"
osource "/home/ah/Documents/Workspace/STM32/ZephyrProject/zephyr/soc/openisa/rv32m1/Kconfig"
osource "/home/ah/Documents/Workspace/STM32/ZephyrProject/zephyr/soc/nxp/s32/Kconfig"
osource "/home/ah/Documents/Workspace/STM32/ZephyrProject/zephyr/soc/nxp/rw/Kconfig"
osource "/home/ah/Documents/Workspace/STM32/ZephyrProject/zephyr/soc/nxp/mcx/Kconfig"
osource "/home/ah/Documents/Workspace/STM32/ZephyrProject/zephyr/soc/nxp/lpc/Kconfig"
osource "/home/ah/Documents/Workspace/STM32/ZephyrProject/zephyr/soc/nxp/layerscape/Kconfig"
osource "/home/ah/Documents/Workspace/STM32/ZephyrProject/zephyr/soc/nxp/kinetis/Kconfig"
osource "/home/ah/Documents/Workspace/STM32/ZephyrProject/zephyr/soc/nxp/imxrt/Kconfig"
osource "/home/ah/Documents/Workspace/STM32/ZephyrProject/zephyr/soc/nxp/imx/Kconfig"
osource "/home/ah/Documents/Workspace/STM32/ZephyrProject/zephyr/soc/nuvoton/numicro/Kconfig"
osource "/home/ah/Documents/Workspace/STM32/ZephyrProject/zephyr/soc/nuvoton/numaker/Kconfig"
osource "/home/ah/Documents/Workspace/STM32/ZephyrProject/zephyr/soc/nuvoton/npcx/Kconfig"
osource "/home/ah/Documents/Workspace/STM32/ZephyrProject/zephyr/soc/nuvoton/npcm/Kconfig"
osource "/home/ah/Documents/Workspace/STM32/ZephyrProject/zephyr/soc/nordic/Kconfig"
osource "/home/ah/Documents/Workspace/STM32/ZephyrProject/zephyr/soc/neorv32/Kconfig"
osource "/home/ah/Documents/Workspace/STM32/ZephyrProject/zephyr/soc/native/inf_clock/Kconfig"
osource "/home/ah/Documents/Workspace/STM32/ZephyrProject/zephyr/soc/microchip/miv/Kconfig"
osource "/home/ah/Documents/Workspace/STM32/ZephyrProject/zephyr/soc/microchip/mec/Kconfig"
osource "/home/ah/Documents/Workspace/STM32/ZephyrProject/zephyr/soc/mediatek/mt8xxx/Kconfig"
osource "/home/ah/Documents/Workspace/STM32/ZephyrProject/zephyr/soc/lowrisc/opentitan/Kconfig"
osource "/home/ah/Documents/Workspace/STM32/ZephyrProject/zephyr/soc/litex/litex_vexriscv/Kconfig"
osource "/home/ah/Documents/Workspace/STM32/ZephyrProject/zephyr/soc/ite/ec/Kconfig"
osource "/home/ah/Documents/Workspace/STM32/ZephyrProject/zephyr/soc/intel/raptor_lake/Kconfig"
osource "/home/ah/Documents/Workspace/STM32/ZephyrProject/zephyr/soc/intel/lakemont/Kconfig"
osource "/home/ah/Documents/Workspace/STM32/ZephyrProject/zephyr/soc/intel/intel_socfpga_std/Kconfig"
osource "/home/ah/Documents/Workspace/STM32/ZephyrProject/zephyr/soc/intel/intel_socfpga/Kconfig"
osource "/home/ah/Documents/Workspace/STM32/ZephyrProject/zephyr/soc/intel/intel_niosv/Kconfig"
osource "/home/ah/Documents/Workspace/STM32/ZephyrProject/zephyr/soc/intel/intel_ish/Kconfig"
osource "/home/ah/Documents/Workspace/STM32/ZephyrProject/zephyr/soc/intel/intel_adsp/Kconfig"
osource "/home/ah/Documents/Workspace/STM32/ZephyrProject/zephyr/soc/intel/elkhart_lake/Kconfig"
osource "/home/ah/Documents/Workspace/STM32/ZephyrProject/zephyr/soc/intel/atom/Kconfig"
osource "/home/ah/Documents/Workspace/STM32/ZephyrProject/zephyr/soc/intel/apollo_lake/Kconfig"
osource "/home/ah/Documents/Workspace/STM32/ZephyrProject/zephyr/soc/intel/alder_lake/Kconfig"
osource "/home/ah/Documents/Workspace/STM32/ZephyrProject/zephyr/soc/infineon/cat3/Kconfig"
osource "/home/ah/Documents/Workspace/STM32/ZephyrProject/zephyr/soc/infineon/cat1b/Kconfig"
osource "/home/ah/Documents/Workspace/STM32/ZephyrProject/zephyr/soc/infineon/cat1a/Kconfig"
osource "/home/ah/Documents/Workspace/STM32/ZephyrProject/zephyr/soc/gd/gd32/Kconfig"
osource "/home/ah/Documents/Workspace/STM32/ZephyrProject/zephyr/soc/gaisler/leon3/Kconfig"
osource "/home/ah/Documents/Workspace/STM32/ZephyrProject/zephyr/soc/gaisler/gr716a/Kconfig"
osource "/home/ah/Documents/Workspace/STM32/ZephyrProject/zephyr/soc/espressif/Kconfig"
osource "/home/ah/Documents/Workspace/STM32/ZephyrProject/zephyr/soc/ene/kb1200/Kconfig"
osource "/home/ah/Documents/Workspace/STM32/ZephyrProject/zephyr/soc/efinix/sapphire/Kconfig"
osource "/home/ah/Documents/Workspace/STM32/ZephyrProject/zephyr/soc/cdns/xtensa_sample_controller/Kconfig"
osource "/home/ah/Documents/Workspace/STM32/ZephyrProject/zephyr/soc/cdns/sample_controller32/Kconfig"
osource "/home/ah/Documents/Workspace/STM32/ZephyrProject/zephyr/soc/cdns/dc233c/Kconfig"
osource "/home/ah/Documents/Workspace/STM32/ZephyrProject/zephyr/soc/brcm/bcmvk/Kconfig"
osource "/home/ah/Documents/Workspace/STM32/ZephyrProject/zephyr/soc/brcm/bcm2712/Kconfig"
osource "/home/ah/Documents/Workspace/STM32/ZephyrProject/zephyr/soc/brcm/bcm2711/Kconfig"
osource "/home/ah/Documents/Workspace/STM32/ZephyrProject/zephyr/soc/atmel/sam0/Kconfig"
osource "/home/ah/Documents/Workspace/STM32/ZephyrProject/zephyr/soc/atmel/sam/Kconfig"
osource "/home/ah/Documents/Workspace/STM32/ZephyrProject/zephyr/soc/aspeed/Kconfig"
osource "/home/ah/Documents/Workspace/STM32/ZephyrProject/zephyr/soc/arm/Kconfig"
osource "/home/ah/Documents/Workspace/STM32/ZephyrProject/zephyr/soc/arm/beetle/Kconfig"
osource "/home/ah/Documents/Workspace/STM32/ZephyrProject/zephyr/soc/andestech/Kconfig"
osource "/home/ah/Documents/Workspace/STM32/ZephyrProject/zephyr/soc/amd/acp_6_0/Kconfig"
osource "/home/ah/Documents/Workspace/STM32/ZephyrProject/zephyr/soc/ambiq/Kconfig"
osource "/home/ah/Documents/Workspace/STM32/ZephyrProject/zephyr/soc/altr/zephyr_nios2f/Kconfig"
osource "/home/ah/Documents/Workspace/STM32/ZephyrProject/zephyr/soc/altr/qemu_nios2/Kconfig"
osource "/home/ah/Documents/Workspace/STM32/ZephyrProject/zephyr/soc/adi/max32/Kconfig"
```
